## Kconfig
```kconfig
# Copyright (c) 2026 hringdrifi
# SPDX-License-Identifier: MIT

config BIFROST_TRACKBALL_DIAGNOSTICS
    bool "Log Bifrost trackball readiness, motion pin and input events"
    depends on INPUT && GPIO
    depends on DT_HAS_PIXART_PMW3610_ENABLED || DT_HAS_PIXART_PMW3610_ALT_ENABLED
    default n
```

## boards/arm/bifrost_left/bifrost_left_defconfig
```kconfig
CONFIG_GPIO=y
CONFIG_BT=y
CONFIG_ZMK_BLE=y
CONFIG_INPUT=y
CONFIG_ZMK_POINTING=y

CONFIG_FLASH=y
CONFIG_SETTINGS=y
CONFIG_SETTINGS_NVS=y
CONFIG_BUILD_OUTPUT_HEX=y
CONFIG_PINCTRL=y
CONFIG_CLOCK_CONTROL=y
CONFIG_FLASH_PAGE_LAYOUT=y
CONFIG_NVS=y
CONFIG_MPU_ALLOW_FLASH_WRITE=y

CONFIG_RETAINED_MEM=y
CONFIG_RETENTION=y
CONFIG_RETENTION_BOOT_MODE=y
```

## boards/arm/bifrost_left/board.yml
```yaml
# Copyright (c) 2026 hringdrifi
# SPDX-License-Identifier: MIT

board:
  name: bifrost_left
  vendor: hringbord
  socs:
    - name: nrf52840
```

## boards/arm/bifrost_right/Kconfig.defconfig
```kconfig
# Copyright (c) 2026 Hringbord
# SPDX-License-Identifier: MIT

if BOARD_BIFROST_RIGHT

config BOARD
    default "bifrost_right"


config ZMK_SPLIT
    default y

config ZMK_BLE
    default y



endif
```

## boards/arm/bifrost_right/board.yml
```yaml
board:
  name: bifrost_right
  vendor: hringbord
  socs:
    - name: nrf52840
      variants:
        - name: zmk
```

## boards/hringbord/bifrost_left/bifrost_left_defconfig
```kconfig
# Copyright (c) 2026 hringdrifi
# SPDX-License-Identifier: MIT

CONFIG_GPIO=y
CONFIG_SPI=y
CONFIG_WS2812_STRIP_SPI=y
CONFIG_ZMK_EXT_POWER=y
CONFIG_ZMK_RGB_UNDERGLOW=y
CONFIG_ZMK_RGB_UNDERGLOW_EXT_POWER=y
CONFIG_ZMK_RGB_UNDERGLOW_ON_START=y
CONFIG_ZMK_RGB_UNDERGLOW_SAT_START=0
CONFIG_ZMK_RGB_UNDERGLOW_BRT_START=20
CONFIG_ZMK_POINTING=y

CONFIG_FLASH=y
CONFIG_FLASH_MAP=y
CONFIG_SETTINGS=y
CONFIG_SETTINGS_NVS=y
CONFIG_USE_DT_CODE_PARTITION=y
CONFIG_BUILD_OUTPUT_UF2=y
CONFIG_PINCTRL=y
CONFIG_CLOCK_CONTROL=y
CONFIG_FLASH_PAGE_LAYOUT=y
CONFIG_NVS=y
CONFIG_MPU_ALLOW_FLASH_WRITE=y

CONFIG_RETAINED_MEM=y
CONFIG_RETENTION=y
CONFIG_RETENTION_BOOT_MODE=y
```

## boards/hringbord/bifrost_right/Kconfig.bifrost_right
```kconfig
# Copyright (c) 2026 hringdrifi
# SPDX-License-Identifier: MIT

config BOARD_BIFROST_RIGHT
    select SOC_NRF52840_QIAA
    select ZMK_BOARD_COMPAT
    imply RETAINED_MEM
    imply RETENTION
    imply RETENTION_BOOT_MODE
```

## boards/hringbord/bifrost_right/Kconfig.defconfig
```kconfig
# Copyright (c) 2026 hringdrifi
# SPDX-License-Identifier: MIT

if BOARD_BIFROST_RIGHT

config BOARD
    default "bifrost_right"

choice ZMK_BOOTMODE_MAGIC_VALUE_BOOTLOADER_TYPE
    default ZMK_BOOTMODE_MAGIC_VALUE_BOOTLOADER_TYPE_ADAFRUIT_NRF52
endchoice

config ZMK_SPLIT
    default y

config ZMK_BLE
    default y

endif # BOARD_BIFROST_RIGHT
```

## boards/hringbord/bifrost_right/board.yml
```yaml
# Copyright (c) 2026 hringdrifi
# SPDX-License-Identifier: MIT

board:
  name: bifrost_right
  vendor: hringbord
  socs:
    - name: nrf52840
```

## config/boards/arm/bifrost_left/Kconfig.bifrost_left
```kconfig
# Copyright (c) 2026 Hringbord
# SPDX-License-Identifier: MIT

config BOARD_BIFROST_LEFT
    bool "Bifrost left"
    select SOC_NRF52840_QIAA
```

## config/boards/arm/bifrost_left/Kconfig.board
```kconfig
# Copyright (c) 2026 Hringbord
# SPDX-License-Identifier: MIT

config BOARD_BIFROST_LEFT
    bool "Bifrost left"
```

## config/boards/arm/bifrost_left/bifrost_left_defconfig
```kconfig
CONFIG_GPIO=y
CONFIG_SOC_SERIES_NRF52X=y
CONFIG_SOC_NRF52840_QIAA=y
CONFIG_ZMK_BLE=y

CONFIG_FLASH=y
CONFIG_BUILD_OUTPUT_HEX=y
CONFIG_PINCTRL=y
CONFIG_CLOCK_CONTROL=y
CONFIG_FLASH_PAGE_LAYOUT=y
CONFIG_NVS=y
CONFIG_MPU_ALLOW_FLASH_WRITE=y
```

## config/boards/arm/bifrost_right/Kconfig.board
```kconfig
# Copyright (c) 2026 Hringbord
# SPDX-License-Identifier: MIT

config BOARD_BIFROST_RIGHT
    bool "Bifrost right"
```

## config/boards/arm/bifrost_right/bifrost_right_defconfig
```kconfig
CONFIG_GPIO=y
CONFIG_SOC_SERIES_NRF52X=y
CONFIG_SOC_NRF52840_QIAA=y
CONFIG_BT=y
CONFIG_ZMK_BLE=y

CONFIG_FLASH=y
CONFIG_SETTINGS=y
CONFIG_SETTINGS_NVS=y
CONFIG_BUILD_OUTPUT_HEX=y
CONFIG_PINCTRL=y
CONFIG_CLOCK_CONTROL=y
CONFIG_FLASH_PAGE_LAYOUT=y
CONFIG_NVS=y
CONFIG_MPU_ALLOW_FLASH_WRITE=y

CONFIG_RETAINED_MEM=y
CONFIG_RETENTION=y
CONFIG_RETENTION_BOOT_MODE=y
```

## config/boards/hringbord/bifrost_left/Kconfig.bifrost_left
```kconfig
# Copyright (c) 2026 Hringbord
# SPDX-License-Identifier: MIT

config BOARD_BIFROST_LEFT
    bool "Bifrost left"
    select SOC_NRF52840_QIAA
    select ZMK_BOARD_COMPAT if BOARD_BIFROST_LEFT_NRF52840_ZMK
```

## config/boards/hringbord/bifrost_right/Kconfig.bifrost_right
```kconfig
# Copyright (c) 2026 Hringbord
# SPDX-License-Identifier: MIT

config BOARD_BIFROST_RIGHT
    bool "Bifrost right"
    select SOC_NRF52840_QIAA
    select ZMK_BOARD_COMPAT if BOARD_BIFROST_RIGHT_NRF52840_ZMK
```

## config/west.yml
```yaml
# Copyright (c) 2026 hringdrifi
# SPDX-License-Identifier: MIT

manifest:
  remotes:
    - name: zmkfirmware
      url-base: https://github.com/zmkfirmware
    - name: badjeff
      url-base: https://github.com/badjeff
  projects:
    - name: zmk
      remote: zmkfirmware
      import: app/west.yml
      revision: main
    - name: zmk-pmw3610-driver
      remote: badjeff
      revision: e970029b42f33613ca8f05baf311dc733cd5a390
    - name: zmk-feature-liki
      url: https://github.com/hringdrifi/zmk-feature-liki
      revision: 0b38567d389936f5ed2d9f93fddef0d3f9c514c2
  self:
    path: config
```

## zephyr/Kconfig
```kconfig
config BIFROST_RGB_DIAGNOSTICS
    bool "Bifrost thumb RGB signal diagnostics"
    depends on SHELL && WS2812_STRIP_GPIO && ZMK_RGB_UNDERGLOW && ZMK_EXT_POWER
    help
      Add a USB shell command to inspect RGB state and hold the thumb LED
      data line low or high for multimeter measurements. Disabled by default.

config BIFROST_RGB_AUTO_TEST
    bool "Bifrost automatic RGB data-line voltage test"
    depends on WS2812_STRIP_GPIO && ZMK_RGB_UNDERGLOW && ZMK_EXT_POWER
    depends on !BIFROST_RGB_DIAGNOSTICS
    help
      Stop RGB animation after startup, then use a dedicated thread to drive
      LED power and alternate P0.27 low/high every ten seconds. RGB or external
      power subsystem errors do not cancel the GPIO voltage test.
```
